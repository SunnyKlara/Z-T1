## firmware/zcritical-esp/sdkconfig.defaults
```kconfig
# ═══════════════════════════════════════════════════════════════
# STEER: 反臃肿 | max_lines=50 | scope=firmware
#
# 职责: ESP-IDF SDK 默认配置 — ESP32-S3 + BLE + Wi-Fi
# 硬件参数: steering/specs/hardware-config.md
# BLE参数: steering/specs/protocol-contract.md
# ═══════════════════════════════════════════════════════════════

# ESP32-S3
CONFIG_IDF_TARGET_ESP32S3=y
CONFIG_IDF_TARGET="esp32s3"

# Bluetooth — BLE only (no Classic BT)
CONFIG_BT_ENABLED=y
CONFIG_BT_BLUEDROID_ENABLED=y
CONFIG_BT_BLE_42_FEATURES_SUPPORTED=y
CONFIG_BT_BLE_DYNAMIC_ENV_MEMORY=y
CONFIG_BT_ALLOCATION_FROM_SPIRAM_FIRST=y
CONFIG_BT_CLASSIC_ENABLED=n

# Disable BLE SMP / security pairing (no bond required)
CONFIG_BT_BLE_SMP_ENABLE=n
CONFIG_BT_SMP_ENABLE=n
CONFIG_BT_CTRL_BLE_SECURITY_ENABLE=n

# Wi-Fi
CONFIG_ESP_WIFI_ENABLED=y
CONFIG_ESP_WIFI_STATIC_RX_BUFFER_NUM=4
CONFIG_ESP_WIFI_DYNAMIC_RX_BUFFER_NUM=32
CONFIG_ESP_WIFI_DYNAMIC_TX_BUFFER_NUM=32

# Wi-Fi + BLE coexistence
CONFIG_ESP_COEX_SW_COEXIST_ENABLE=y

# PSRAM — ESP32-S3 内置 Octal PSRAM
CONFIG_SPIRAM=y
CONFIG_SPIRAM_MODE_OCT=y
CONFIG_SPIRAM_SPEED_80M=y
CONFIG_SPIRAM_BOOT_INIT=y
CONFIG_SPIRAM_MALLOC_ALWAYSINTERNAL=4096
CONFIG_SPIRAM_MALLOC_RESERVE_INTERNAL=32768
CONFIG_SPIRAM_ALLOW_BSS_SEG_EXTERNAL_MEMORY=y

# RTOS
CONFIG_FREERTOS_HZ=1000

# LWIP
CONFIG_LWIP_SO_REUSE=y

# Partition table
CONFIG_PARTITION_TABLE_CUSTOM=y
CONFIG_PARTITION_TABLE_CUSTOM_FILENAME="partitions.csv"

# Flash size (实际硬件)
CONFIG_ESPTOOLPY_FLASHSIZE_16MB=y
CONFIG_ESPTOOLPY_FLASHSIZE="16MB"

# ═══════════════════════════════════════════════════════════════
#  LVGL 9.x 配置（UI demo 分支）
# ═══════════════════════════════════════════════════════════════
CONFIG_LV_CONF_SKIP=n

# 颜色深度 RGB565
CONFIG_LV_COLOR_DEPTH_16=y
CONFIG_LV_COLOR_16_SWAP=y

# 内存：64KB 控件堆，从 PSRAM
CONFIG_LV_USE_STDLIB_MALLOC=LV_STDLIB_BUILTIN
CONFIG_LV_MEM_SIZE_KILOBYTES=64

# 字体（启用大字号供仪表盘用）
CONFIG_LV_FONT_MONTSERRAT_14=y
CONFIG_LV_FONT_MONTSERRAT_20=y
CONFIG_LV_FONT_MONTSERRAT_28=y
CONFIG_LV_FONT_MONTSERRAT_48=y
CONFIG_LV_FONT_DEFAULT_MONTSERRAT_14=y

# 控件
CONFIG_LV_USE_ARC=y
CONFIG_LV_USE_BAR=y
CONFIG_LV_USE_BUTTON=y
CONFIG_LV_USE_LABEL=y
CONFIG_LV_USE_IMAGE=y
CONFIG_LV_USE_OBJ_NAME=y

# 动画 + 显示
CONFIG_LV_USE_ANIMATION=y
CONFIG_LV_USE_REFR_DEBUG=n

# Tick 由我们调用 lv_tick_inc，禁用 LV 自带定时器
CONFIG_LV_TICK_PERIOD_MS=2

# 内部双缓冲启用（LVGL 自己管理）
CONFIG_LV_DRAW_BUF_ALIGN=4
```
